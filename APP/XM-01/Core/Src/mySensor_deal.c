#include "mySensor_deal.h"

/* 帧长度保持1024字节，输出改为160点 (2026-05-06) */
#define FRAME_LEN                     1024
#define FRAME_HEADER_LEN              4
#define DEBUG_MODE                    0 /* DEBUG_MODE=1时，使用测试数据，不使用传感器数据，但需要传感器数据触发中断 */

static uint8_t local_buf[2048] = {0};
uint8_t Origin_MattressData_Resize[FRAME_LEN];
uint8_t Origin_MattressData[160];  /* 16x10矩阵，1024→160映射输出 (2026-05-06) */
const uint8_t FRAME_HEADER[FRAME_HEADER_LEN] = {0xAA, 0x55, 0x03, 0x99};

#if DEBUG_MODE
/* 测试数据: 160点测试数据占位 (2026-05-06) */
static const uint8_t test_data_160[160] = {
    0, 0, 0, 0, 0, 0, 0, 0, 0, 0, 0, 0, 0, 0, 0, 0, 0, 0, 0, 0,
    0, 0, 0, 0, 0, 0, 0, 0, 0, 0, 0, 0, 0, 0, 0, 0, 0, 0, 0, 0,
    0, 0, 0, 0, 0, 0, 0, 0, 0, 0, 0, 0, 0, 0, 0, 0, 0, 0, 0, 0,
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    0, 0, 0, 0, 0, 0, 0, 0, 0, 0, 0, 0, 0, 0, 0, 0, 0, 0, 0, 0
};
unsigned char test_data[1024] =
{
   //2-1-2 0, 0, 0, 0, 0, 0, 0, 0, 0, 0, 0, 0, 0,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 0
   //1-1 0, 0, 0, 0, 0, 0, 0, 0, 0, 0, 0, 0, 0,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 0
   0, 0, 0, 0, 0, 0, 0, 0, 0, 0, 0, 0,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 0
   //0, 0, 0, 0, 0, 0, 0, 0, 0, 0, 0, 0, 0,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 0
   //1-2 0, 0, 0, 0, 0, 0, 0, 0, 0, 0, 0, 0, 0,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 0
   //1-2 0, 0, 0, 0, 0, 0, 0, 0, 0, 0, 0, 0, 0,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 0

};

// 测试数据160字节占位（原260字节测试数据已废弃，改为160点）(2026-05-06)
unsigned char test_data_160_raw[160] =
{
    0,   0,   0,   0,   0,   0,  18,   0,   0,   7,
    0,   0,   0,   0,   7,   0,  10,   0,  21,   0,
    0,   0,   0,   0,   0,   0,   8,   0,   0,   0,
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    0,   0,   0,   0,   0,  17,   5,   0,   0,   0
};
#endif
/*------------------/-------------------/-------------------/------------------/
 * @brief   
 * @param   none
 * @return  none
 * @note    none
/-------------------/-------------------/-------------------/-----------------*/
static void myUSART2_DMA_Disable(void)
{
    HAL_UART_DMAPause(&huart2);
}

/*------------------/-------------------/-------------------/------------------/
 * @brief   
 * @param   none
 * @return  none.
 * @note    none
/-------------------/-------------------/-------------------/-----------------*/
static void myUSART2_DMA_Enable(void)
{
    HAL_UART_DMAResume(&huart2);
}

#if 0
/*------------------/-------------------/-------------------/------------------/
 * @brief   生成1024点的正弦波模拟数据
 * @param   none
 * @return  none.
 * @note    none
/-------------------/-------------------/-------------------/-----------------*/
static void generate_sine_wave(uint8_t data[1024])
{
    const double PI = 3.14159265358979323846;
    for (int i = 0; i < 1024; i++)
    {
        // 生成0-255范围内的正弦波数据
        double value = sin(2.0 * PI * i / 1024.0);  // -1.0到1.0
        data[i] = (uint8_t)((value + 1.0) * 127.5); // 映射到0-255
    }
}

/*------------------/-------------------/-------------------/------------------/
 * @brief   数据打印
 * @param   none
 * @return  none.
 * @note    none
/-------------------/-------------------/-------------------/-----------------*/
static void uart_data_process(uint8_t *data, uint16_t len)
{
    rt_kprintf("UART RX [%d bytes]: ", len);
    for (int i = 0; i < len; i++)
    {
        rt_kprintf("%02X ", data[i]);
    }
    rt_kprintf("\n");
}

/*------------------/-------------------/-------------------/------------------/
 * @brief  
 * @param   none
 * @return  none.
 * @note    none
/-------------------/-------------------/-------------------/-----------------*/
static void flip_rows_range(uint8_t *mat, int row_start, int row_end, int cols)
{
    while (row_start < row_end)
    {
        for (int j = 0; j < cols; ++j)
        {
            int idx1 = row_start * cols + j;
            int idx2 = row_end * cols + j;
            int tmp = mat[idx1];
            mat[idx1] = mat[idx2];
            mat[idx2] = tmp;
        }
        row_start++;
        row_end--;
    }
}
#endif

/**
 * @brief 从1024个原始传感点预处理成160个点的输入矩阵
 * @description
 *  映射规则（来自 docs/sensor_mapping.md）：
 *  1. 将1024字节看作32×32矩阵（行优先）
 *  2. 仅使用左上角16×10子矩阵（行0-15，列0-9）
 *  3. 行重排规则（0-based索引）：
 *     - 子矩阵行 r ∈ [0,7]  → 输出索引 (15-r)*10 + c  （输出位置81-160）
 *     - 子矩阵行 r ∈ [8,15] → 输出索引 (r-8)*10  + c  （输出位置1-80）
 * @param raw_1024_data 指向1024字节原始传感器数据的指针
 * @param output_160_data 指向输出160字节数组的指针（用于模型推理）
 * (2026-05-06)
 */
extern void preprocess_1024_to_160(const rt_uint8_t *raw_1024_data, rt_uint8_t *output_160_data)
{
    int r, c, out_idx;
    /* 遍历16×10子矩阵，按映射规则填充输出数组 (2026-05-06) */
    for (r = 0; r < 16; r++)
    {
        for (c = 0; c < 10; c++)
        {
            if (r <= 7)
                out_idx = (15 - r) * 10 + c;  /* 行0-7 → 输出位置81-160 */
            else
                out_idx = (r - 8) * 10 + c;   /* 行8-15 → 输出位置1-80 */
            output_160_data[out_idx] = raw_1024_data[r * 32 + c];
        }
    }
}

/**
 * 从 DMA 接收缓存中查找并提取一帧数据
 * @param dma_buf DMA缓存数组
 * @param dma_len 实际接收长度
 * @return RT_TRUE表示找到并提取成功，RT_FALSE表示未找到
 */

/*------------------/-------------------/-------------------/------------------/
 * @brief   
 * @param   none
 * @return  none.
 * @note    none
/-------------------/-------------------/-------------------/-----------------*/
rt_bool_t extract_mattress_frame(const uint8_t *dma_buf, size_t dma_len)
{
    (void)dma_buf; /* 未使用的参数 (2026-05-06) */
    /* 本地缓存用于查找帧尾，不修改原始DMA缓存 (2026-05-06) */
    if (dma_len > sizeof(local_buf))
    {
        rt_kprintf("Data error to cache\n");
        return RT_FALSE;
    }
    /* 查找帧尾标识符 AA 55 03 99，数据在标识符之前，与InDevelop项目一致 (2026-05-06) */
    {
        size_t i;
        for (i = FRAME_LEN; i + FRAME_HEADER_LEN <= dma_len; i++)
        {
            if (rt_memcmp(&local_buf[i], FRAME_HEADER, FRAME_HEADER_LEN) == 0)
            {
                #if DEBUG_MODE
                /* 直接注入160字节测试数据，跳过256->160转换 (2026-05-06) */
                rt_memcpy(Origin_MattressData, test_data_160, sizeof(Origin_MattressData));
                #else
                /* 标识符前的256字节即为一帧数据 (2026-05-06) */
                rt_memcpy(Origin_MattressData_Resize, &local_buf[i - FRAME_LEN], FRAME_LEN);
                preprocess_1024_to_160(Origin_MattressData_Resize, Origin_MattressData);  /* 1024→160点预处理 (2026-05-06) */
                #endif
                rt_memcpy(UploadSrcMattressData, Origin_MattressData, sizeof(UploadSrcMattressData));
                return RT_TRUE;
            }
        }
    }

    rt_kprintf("No frame end marker found in buffer\n");
    return RT_FALSE;
}

/* 定义线程栈与控制块（静态分配） */
#define SENSOR_THREAD_STACK_SIZE (1024 * 2)  // 优化：4KB->2KB 减少内存消耗 (2025-09-03)
struct rt_event uart_rx_event;               // 静态事件对象;
struct rt_event data_ready_event;            // 静态事件对象;
static struct rt_thread sensor_thread;
static rt_uint8_t sensor_thread_stack[SENSOR_THREAD_STACK_SIZE];

/*------------------/-------------------/-------------------/------------------/
 * @brief   线程入口函数
 * @param   none
 * @return  none.
 * @note    none
/-------------------/-------------------/-------------------/-----------------*/
static void sensor_thread_entry(void *parameter)
{
    rt_uint32_t e;
    rt_memset(local_buf, 0, sizeof(local_buf));
    while (1)
    {
        if (rt_event_recv(&uart_rx_event, 0x01, RT_EVENT_FLAG_OR | RT_EVENT_FLAG_CLEAR, RT_WAITING_FOREVER, &e) == RT_EOK)
        {
            if (sensor_uart_rx_len < 1024)  /* 最小帧长度：1024字节数据 (2026-05-06) */
                continue;
			
            rt_enter_critical();
            myUSART2_DMA_Disable();
            rt_memcpy(local_buf, sensor_uart_rx_buffer, sizeof(local_buf));
            myUSART2_DMA_Enable();
            // 临界区代码（可重入）
            rt_exit_critical();
            rt_memset(Origin_MattressData, 0, sizeof(Origin_MattressData));
            // 处理函数 拷贝 成功
            #if DEBUG_MODE
            rt_kprintf("[DBG] calling extract, rx_len=%d\n", sensor_uart_rx_len);
            #endif
            if (extract_mattress_frame(sensor_uart_rx_buffer, sizeof(sensor_uart_rx_buffer)))
            {
                model.status = AI_STATUS_IDLE;
                rt_event_send(&data_ready_event, 0x01);
            }
            rt_memset(sensor_uart_rx_buffer, 0, sizeof(sensor_uart_rx_buffer));
        }
        rt_thread_mdelay(15);
    }
}

/*------------------/-------------------/-------------------/------------------/
 * @brief   传感器线程初始化函数
 * @param   none
 * @return  none.
 * @note    none
/-------------------/-------------------/-------------------/-----------------*/
int sensor_thread_init(void)
{
    rt_err_t result1 = rt_event_init(&uart_rx_event, "uart_rx_evt", RT_IPC_FLAG_FIFO);
    rt_err_t result2 = rt_event_init(&data_ready_event, "data_ready_event", RT_IPC_FLAG_FIFO);
    if (result1 != RT_EOK || result2 != RT_EOK)
        return -RT_ERROR;
    rt_thread_init(&sensor_thread,              // 线程控制块
                   "sensor_task",               // 名称
                   sensor_thread_entry,         // 入口函数
                   RT_NULL,                     // 参数
                   &sensor_thread_stack[0],     // 栈起始地址
                   sizeof(sensor_thread_stack), // 栈大小
                   8,                           // 优先级(高)
                   10);                         // 时间片
    rt_thread_startup(&sensor_thread);          // 启动线程

    return RT_EOK;
}
INIT_APP_EXPORT(sensor_thread_init);

